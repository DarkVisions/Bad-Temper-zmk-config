## boards/shields/temper/Kconfig.defconfig
```kconfig
if SHIELD_TEMPER_LEFT

config ZMK_KEYBOARD_NAME
    default "Bad Temper"

config ZMK_SPLIT_ROLE_CENTRAL
    default y

config USB_DEVICE_PRODUCT
    default "Bad Temper - wired"

endif

if SHIELD_TEMPER_LEFT || SHIELD_TEMPER_RIGHT

config ZMK_SPLIT
    default y

endif
```

## config/west.yml
```yaml
manifest:
  remotes:
    - name: zmkfirmware
#    - name: Bad-Temper-zmk-config
      url-base: https://github.com/zmkfirmware
#      url-base: https://github.com/DarkVisons/Bad-Temper-zmk-config
  projects:
    - name: zmk
      remote: zmkfirmware
      revision: v0.3
      import: app/west.yml
  self:
    path: config
include:
  - board: nice_nano
    shield: temper_left nice_view_adapter nice_view
  - board: nice_nano
    shield: temper_right nice_view_adapter nice_view

# ZMK modules stolen from urob
  - name: zmk-adaptive-key
    path: modules/zmk/adaptive-key
  - name: zmk-auto-layer
    path: modules/zmk/auto-layer
  - name: zmk-helpers
    path: modules/zmk/helpers
  - name: zmk-leader-key
    path: modules/zmk/leader-key
  - name: zmk-tri-state
    path: modules/zmk/tri-state
  - name: zmk-unicode
    path: modules/zmk/unicode
```
